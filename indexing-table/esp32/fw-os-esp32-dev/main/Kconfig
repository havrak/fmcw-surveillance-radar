## indexing-table/esp32/fw-os-esp32-dev/main/Kconfig
```kconfig
menu "Indexing Table Configuration"

config COMM_MQTT_BROKER_URL
string "COMM_MQTT Broker URL"
default "mqtt://broker.hivemq.com"
help
	URL of the broker to connect to

config COMM_MQTT_PASSWORD_PROTECTED

bool "COMM_MQTT Password Protected"
default false
help
	Enable password protection for MQTT

config COMM_MQTT_BROKER_USERNAME
string "COMM_MQTT Username"
default ""
depends on COMM_MQTT_PASSWORD_PROTECTED
help
	Username to use for authentication

config COMM_MQTT_BROKER_PASSWORD
string "COMM_MQTT Password"
default ""
depends on COMM_MQTT_PASSWORD_PROTECTED
help
	Password to use for authentication

config COMM_RS232_BUFFER_SIZE
int "COMM RS232 communication buffer Size"
range 128 4096
default 1024
help
	Size of the buffer for RS232

choice COMM_RS232_BAUDRATE
prompt "COMM RS232 communication baudrate"
default COMM_RS232_BAUDRATE_115200
help
	Baudrate for RS232

config COMM_RS232_BAUDRATE_9600
bool '9600'
config COMM_RS232_BAUDRATE_19200
bool '19200'
config COMM_RS232_BAUDRATE_38400
bool '38400'
config COMM_RS232_BAUDRATE_57600
bool '57600'
config COMM_RS232_BAUDRATE_115200
bool '115200'
endchoice

config COMM_RS232_BAUDRATE
int
default 115200 if COMM_RS232_BAUDRATE_115200
default 57600 if COMM_RS232_BAUDRATE_57600
default 38400 if COMM_RS232_BAUDRATE_38400
default 19200 if COMM_RS232_BAUDRATE_19200
default 9600 if COMM_RS232_BAUDRATE_9600

config COMM_ENABLE_LOCKS
bool "Enable locks for communication"
default true
help
	Enable locks to prevent concurrent access to the processing queue

config MOTR_DEBUG
bool "Enable motor debug"
default n
help
	Enable debug messages for motor

config MOTR_DEFAULT_SPEED
int "Default motor speed in RPM"
range 1 500
default 10
help
	Default speed of the motor in RPM

config MOTR_MAX_SPEED
int "Maximum motor speed in RPM"
range 1 300
default 250
help
	Maximum speed of the motor in RPM

config MOTR_4WIRE_MODE
bool "Steppers connected with 4 wires"
default y
help
	Enable if the steppers are connected with 4 wires



config MOTR_H_STEP_COUNT
int "Horizontal motor rotation step count"
range 1 1000
default 200
help
	Number of steps to rotate one revolution the motor in horizontal axis

config MOTR_H_ENDSTOP
int  "Horizontal motor endstop pin"
default  -1
range -1 100
help
	GPIO pin number of the endstop of the motor in horizontal axis, -1 for no endstop

config MOTR_H_MICROSTEPPING
int "Horizontal motor microstepping"
range 1 16
default 1
help
	Microstepping of the motor in horizontal axis



config MOTR_H_GEAR_RATIO
int "Horizontal motor gear ratio (only downgearing is supported)"
range 1 1000
default 1
help
	Horizontal motor gear ratio (only downgearing is supported)


config MOTR_H_PIN1
int "Horizontal motor GPIO connection for pin 1"
range 0 100
default 32
help
	Horizontal motor GPIO connection for pin 1

config MOTR_H_PIN2
int "Horizontal motor GPIO connection for pin 2"
range 0 100
default 33
help
	Horizontal motor GPIO connection for pin 2

config MOTR_H_PIN3
int "Horizontal motor GPIO connection for pin 3"
range 0 100
default 25
depends on MOTR_4WIRE_MODE
help
	Horizontal motor GPIO connection for pin 3

config MOTR_H_PIN4
int "Horizontal motor GPIO connection for pin 4"
range 0 100
default 26
depends on MOTR_4WIRE_MODE
help
	Horizontal motor GPIO connection for pin 4

config MOTR_H_FAULT_PIN
int "Motor horizontal fault GPIO pin"
range -1 100
default -1
help
	GPIO pin number of fault pin of the motor in horizontal axis, -1 for no fault pin


config MOTR_T_STEP_COUNT
int "Tilt motor rotation step count"
range 1 1000
default 200
help
	Number of steps to rotate one revolution the motor in tilt axis

config MOTR_T_ENDSTOP
int  "Tilt motor endstop pin"
default  -1
range -1 100
help
	GPIO pin number of the endstop of the motor in tilt axis, -1 for no endstop

config MOTR_T_MICROSTEPPING
int "Tilt motor microstepping"
range 1 16
default 1
help
	Microstepping of the motor in tilt axis

config MOTR_T_GEAR_RATIO
int "Tilt motor gear ratio (only downgearing is supported)"
range 1 1000
default 1
help
	Tilt motor gear ratio (only downgearing is supported)

config MOTR_T_PIN1
int "Tilt motor GPIO connection for pin 1"
range 0 100
default 27
help
	Tilt motor GPIO connection for pin 1

config MOTR_T_PIN2
int "Tilt motor GPIO connection for pin 2"
range 0 100
default 14
help
	Tilt motor GPIO connection for pin 2

config MOTR_T_PIN3
int "Tilt motor GPIO connection for pin 3"
range 0 100
default 12
depends on MOTR_4WIRE_MODE
help
	Tilt motor GPIO connection for pin 3

config MOTR_T_PIN4
int "Tilt motor GPIO connection for pin 4"
range 0 100
default 13
depends on MOTR_4WIRE_MODE
help
	Tilt motor GPIO connection for pin 4

config MOTR_T_FAULT_PIN
int "Motor tilt fault GPIO pin"
range -1 100
default -1
help
	GPIO pin number of fault pin of the motor in tilt axis, -1 for no fault pin

endmenu
```

## indexing-table/esp32/fw-os-esp32-dev/sdkconfig.defaults
```kconfig
CONFIG_PARTITION_TABLE_CUSTOM=y
CONFIG_PARTITION_TABLE_CUSTOM_FILENAME="partitions.csv"
CONFIG_PARTITION_TABLE_OFFSET=0x8000
CONFIG_PARTITION_TABLE_MD5=y

CONFIG_ESPTOOLPY_FLASHSIZE_2MB=n
CONFIG_ESPTOOLPY_FLASHSIZE_4MB=y
CONFIG_ESPTOOLPY_FLASHSIZE="4MB"

CONFIG_BT_ENABLED=n

CONFIG_PER_DEBUG=y
CONFIG_PER_I2C_SCAN_ENABLE=y
CONFIG_PER_I2C_SCAN_INTERVAL=60000
CONFIG_PER_TASKS_CHECK_ENABLE=y

CONFIG_PER_I2C_LCD_SUPPORT=y
CONFIG_PER_I2C_LCD_DEBUG=n

CONFIG_TSK_SINGLETON_HEAP_SIZE=502

CONFIG_RTC_CLK_SRC_EXT_CRYS=y
CONFIG_RTC_EXT_CRYST_ADDIT_CURRENT_NONE=y

CONFIG_PER_STEPPER_DRIVER_SUPPORT=y
CONFIG_PER_STEPPER_DRIVER_DEBUG=y

CONFIG_WFM_PROBER_SUPPORT=n
CONFIG_WFM_BEACON_SUPPORT=n
```

## indexing-table/esp32/fw-os-esp32-full/main/Kconfig
```kconfig
menu "Indexing Table Configuration"

config COMM_MQTT_BROKER_URL
string "COMM_MQTT Broker URL"
default "mqtt://broker.hivemq.com"
help
	URL of the broker to connect to

config COMM_MQTT_PASSWORD_PROTECTED

bool "COMM_MQTT Password Protected"
default false
help
	Enable password protection for MQTT

config COMM_MQTT_BROKER_USERNAME
string "COMM_MQTT Username"
default ""
depends on COMM_MQTT_PASSWORD_PROTECTED
help
	Username to use for authentication

config COMM_MQTT_BROKER_PASSWORD
string "COMM_MQTT Password"
default ""
depends on COMM_MQTT_PASSWORD_PROTECTED
help
	Password to use for authentication

config COMM_RS232_BUFFER_SIZE
int "COMM RS232 communication buffer Size"
range 128 4096
default 1024
help
	Size of the buffer for RS232

choice COMM_RS232_BAUDRATE
prompt "COMM RS232 communication baudrate"
default COMM_RS232_BAUDRATE_115200
help
	Baudrate for RS232

config COMM_RS232_BAUDRATE_9600
bool '9600'
config COMM_RS232_BAUDRATE_19200
bool '19200'
config COMM_RS232_BAUDRATE_38400
bool '38400'
config COMM_RS232_BAUDRATE_57600
bool '57600'
config COMM_RS232_BAUDRATE_115200
bool '115200'
endchoice

config COMM_RS232_BAUDRATE
int
default 115200 if COMM_RS232_BAUDRATE_115200
default 57600 if COMM_RS232_BAUDRATE_57600
default 38400 if COMM_RS232_BAUDRATE_38400
default 19200 if COMM_RS232_BAUDRATE_19200
default 9600 if COMM_RS232_BAUDRATE_9600

config COMM_ENABLE_LOCKS
bool "Enable locks for communication"
default true
help
	Enable locks to prevent concurrent access to the processing queue

config MOTR_DEBUG
bool "Enable motor debug"
default n
help
	Enable debug messages for motor

config MOTR_DEFAULT_SPEED
int "Default motor speed in RPM"
range 1 500
default 10
help
	Default speed of the motor in RPM

config MOTR_MAX_SPEED
int "Maximum motor speed in RPM"
range 1 300
default 250
help
	Maximum speed of the motor in RPM

config MOTR_H_STEP_COUNT
int "Horizontal motor rotation step count"
range 1 1000
default 200
help
	Number of steps to rotate one revolution the motor in horizontal axis

config MOTR_H_PIN_ENDSTOP
int  "Horizontal motor endstop pin"
default  -1
range -1 100
help
	GPIO pin number of the endstop of the motor in horizontal axis, -1 for no endstop



config MOTR_H_GEAR_RATIO
int "Horizontal motor gear ratio (only downgearing is supported)"
range 1 1000
default 1
help
	Horizontal motor gear ratio (only downgearing is supported)


config MOTR_H_PIN_DIR
int "Horizontal motor GPIO connection direction pin"
range 0 100
default 23
help
	Horizontal motor GPIO connection for direction pin

config MOTR_H_PIN_STEP
int "Horizontal motor GPIO connection for step pin"
range 0 100
default 22
help
	Horizontal motor GPIO connection for step pin

config MOTR_T_STEP_COUNT
int "Tilt motor rotation step count"
range 1 1000
default 200
help
	Number of steps to rotate one revolution the motor in tilt axis

config MOTR_T_PIN_ENDSTOP
int  "Tilt motor endstop pin"
default  -1
range -1 100
help
	GPIO pin number of the endstop of the motor in tilt axis, -1 for no endstop

config MOTR_T_GEAR_RATIO
int "Tilt motor gear ratio (only downgearing is supported)"
range 1 1000
default 1
help
	Tilt motor gear ratio (only downgearing is supported)

config MOTR_T_PIN_DIR
int "Tilt motor GPIO connection for direction pin"
range 0 100
default 19
help
	Tilt motor GPIO connection for direction pin

config MOTR_T_PIN_STEP
int "Tilt motor GPIO connection for step pin"
range 0 100
default 18
help
	Tilt motor GPIO connection for step pin


endmenu
```

## indexing-table/esp32/fw-os-esp32-testing/sdkconfig.defaults
```kconfig
CONFIG_PARTITION_TABLE_CUSTOM=y
CONFIG_PARTITION_TABLE_CUSTOM_FILENAME="partitions.csv"
CONFIG_PARTITION_TABLE_OFFSET=0x8000
CONFIG_PARTITION_TABLE_MD5=y

CONFIG_ESPTOOLPY_FLASHSIZE_2MB=n
CONFIG_ESPTOOLPY_FLASHSIZE_4MB=y
CONFIG_ESPTOOLPY_FLASHSIZE="4MB"

CONFIG_BT_ENABLED=n

CONFIG_PER_DEBUG=n
CONFIG_PER_I2C_SCAN_ENABLE=n
CONFIG_PER_I2C_SCAN_INTERVAL=60000
CONFIG_PER_TASKS_CHECK_ENABLE=n

CONFIG_TSK_SINGLETON_HEAP_SIZE=502

CONFIG_RTC_CLK_SRC_EXT_CRYS=y
CONFIG_RTC_EXT_CRYST_ADDIT_CURRENT_NONE=y

CONFIG_TME_SNTP_EXTENSION_ENABLE=y
CONFIG_TME_TIME_FETCH_INTERVAL=360
CONFIG_TME_SNTP_RETRY_COUNT=5
```

## indexing-table/esp32/main/Kconfig
```kconfig
menu "Indexing Table Configuration"

config COMM_DEBUG
default n
bool "Enable debug for communication layer"
help
	Enable debug messages for  communication layer

config APP_DEBUG
default n
bool "Enable debug for aplication layer"
help
	Enable debug messages for application

config HAL_DEBUG
bool "Enable debug for hal layer"
default n
help
	Enable debug messages for hal layer


config COMM_RS232_BUFFER_SIZE
int "COMM RS232 communication buffer Size"
range 128 4096
default 2048
help
	Size of the buffer for RS232

choice COMM_RS232_BAUDRATE
prompt "COMM RS232 communication baudrate"
default COMM_RS232_BAUDRATE_115200
help
	Baudrate for RS232

config COMM_RS232_BAUDRATE_9600
bool '9600'
config COMM_RS232_BAUDRATE_19200
bool '19200'
config COMM_RS232_BAUDRATE_38400
bool '38400'
config COMM_RS232_BAUDRATE_57600
bool '57600'
config COMM_RS232_BAUDRATE_115200
bool '115200'
config COMM_RS232_BAUDRATE_115200
bool '115200'
endchoice

config COMM_RS232_BAUDRATE
int
default 115200 if COMM_RS232_BAUDRATE_115200
default 57600 if COMM_RS232_BAUDRATE_57600
default 38400 if COMM_RS232_BAUDRATE_38400
default 19200 if COMM_RS232_BAUDRATE_19200
default 9600 if COMM_RS232_BAUDRATE_9600

config STEPPER_YAL_QUEUE_SIZE
int "Queue size for stepper HAL"
range 1 100
default 10
help
	Queue size for stepper HAL

config STEPPER_MAX_SPEED
int "Maximum motor speed in RPM"
range 1 60
default 30
help
	Maximum speed of the motor in RPM

config STEPPER_Y_STEP_COUNT
int "Yaw motor rotation step count"
range 1 1000
default 200
help
	Number of steps to rotate one revolution the motor in yaw, include mechanical reduction or microstepping

config STEPPER_Y_PIN_ENDSTOP
int  "Yaw motor endstop pin"
default  10
range -1 100
help
	GPIO pin number of the endstop of the motor in yaw, -1 for no endstop


config STEPPER_Y_PIN_EN
int "Yaw motor GPIO connection enable pin"
range 0 100
default 6
help
	Yaw motor GPIO connection enable pin


config STEPPER_Y_PIN_STEP
int "Yaw motor GPIO connection for step pin"
range 0 100
default 23
help
	Yaw motor GPIO connection for step pin

config STEPPER_Y_PIN_SENSE
int "Yaw motor GPIO connection for sense pin"
range 0 100
default 22
help
	Yaw motor GPIO connection for sense pin

config STEPPER_Y_PIN_DIR
int "Yaw motor GPIO connection direction pin"
range 0 100
default 21
help
	Yaw motor GPIO connection for direction pin


config STEPPER_P_STEP_COUNT
int "Pitch motor rotation step count"
range 1 1000
default 200
help
	number of steps to rotate one revolution the motor in pitch, include mechanical reduction or microstepping

config STEPPER_P_PIN_ENDSTOP
int  "Pitch motor endstop pin"
default 11
range -1 100
help
	GPIO pin number of the endstop of the motor in pitch, -1 for no endstop

config STEPPER_P_PIN_EN
int "Pitch motor GPIO connection enable pin"
range 0 100
default 7
help
	Pitch motor GPIO connection enable pin

config STEPPER_P_PIN_STEP
int "Pitch motor GPIO connection for step pin"
range 0 100
default 20
help
	Pitch motor GPIO connection for step pin

config STEPPER_P_PIN_SENSE
int "Pitch motor GPIO connection for sense pin"
range 0 100
default 19
help
	Pitch motor GPIO connection for sense pin

config STEPPER_P_PIN_DIR
int "Pitch motor GPIO connection for direction pin"
range 0 100
default 18
help
	Pitch motor GPIO connection for direction pin


config STEPPER_MIN_SPINDLE_TIME
int "Minimum spindle time in ms"
range 1 100000
default 100
help
	Minimum time to wait between two steps in ms. Will give some delay for previous command to be read as it will be cleared by spindle.
endmenu
```
